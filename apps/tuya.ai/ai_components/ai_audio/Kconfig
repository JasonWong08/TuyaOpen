## apps/tuya.ai/ai_components/ai_audio/Kconfig
```kconfig
menuconfig ENABLE_COMP_AI_AUDIO
    select ENABLE_AI_PLAYER
    bool "enable ai audio input/output"
    default y

if (ENABLE_COMP_AI_AUDIO)
    choice
        prompt "select ai audio input codec"
        default ENABLE_COMP_AI_AUDIO_CODEC_PCM

    config ENABLE_COMP_AI_AUDIO_CODEC_PCM
        bool "enable ai audio pcm codec"

    config ENABLE_COMP_AI_AUDIO_CODEC_OPUS
        bool "enable ai audio opus codec"

    config ENABLE_COMP_AI_AUDIO_CODEC_SPEEX
        bool "enable ai audio speex codec"

    endchoice

    choice 
        prompt "select player alert source"
        default AI_PLAYER_ALERT_SOURCE_LOCAL

    config AI_PLAYER_ALERT_SOURCE_LOCAL
        bool "use local alert source"

    config AI_PLAYER_ALERT_SOURCE_CLOUD
        bool "use cloud alert source"

    config AI_PLAYER_ALERT_SOURCE_CUSTOM
        bool "use custom alert source"

    endchoice

    config AI_AUDIO_VAD_ACTIVE_MS
        int "Minimum VAD active time (ms); also sizes recording ringbuf (vad+300 ms)"
        range 0 500
        default 200
        help
          Used by ai_chat_main when AI_AUDIO_VAD_MANUAL is selected.
          Ring buffer bytes ~= (value + 300) * (sample_rate/1000 * bytes_per_sample) + 1.
          Set to 0 on no-PSRAM MCUs to save ~6 KB heap.

endif
```

## apps/tuya.ai/petoi_esp32c3_cube/Kconfig
```kconfig
menu "configure app (petoi_esp32c3_cube)"

config TUYA_PRODUCT_ID
    string "product ID of project"
    default "xlq6xkhdgvx0d0rl"

config ENABLE_BATTERY
    bool "enable the battery module"
    default n

rsource "../ai_components/Kconfig"

endmenu
```

## boards/ESP32/PETOI_ESP32C3_CUBE/Kconfig
```kconfig
config CHIP_CHOICE
    string
    default "esp32c3"

config BOARD_CHOICE
    string
    default "PETOI_ESP32C3_CUBE"

config BOARD_CONFIG
    bool
    default y
    select ENABLE_AUDIO
    select ENABLE_ESP_DISPLAY
    select PLATFORM_FLASHSIZE_16M
    select ENABLE_AUDIO_CODECS
```
