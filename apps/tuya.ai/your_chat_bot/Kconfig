## apps/tuya.ai/your_chat_bot/Kconfig
```kconfig
menu "configure app (your_chat_bot) "

config TUYA_PRODUCT_ID
    string "product ID of project"
    default "gbq0rbhmrnn3greo"

config ENABLE_BATTERY
    bool "enable the battery module"
    default n

config ENABLE_CHAT_BOT_ROBOT_SECOND_UART
    bool "Robot second UART (UART1 TX17/RX18) + MCP self.robot.send_command"
    depends on ENABLE_COMP_AI_MCP
    default n
    help
      Second serial to lower MCU over UART_NUM_1 (default GPIO TX17/RX18, DNESP32S3 BOX / MW53).
      Links your_chat_bot-only MCP tool self.robot.send_command (see robot_uart_ai_system_prompt.h).
      Does not affect other AI apps under apps/tuya.ai.

config ENABLE_QUADDLE_BLE_HID_CENTRAL
    bool "Quaddle BLE HID central for BM769/Q34B gamepad"
    depends on ENABLE_CHAT_BOT_ROBOT_SECOND_UART && ENABLE_BLUETOOTH
    default n
    help
      Scan, connect, subscribe HID/vendor input reports, decode BM769/Q34B frames,
      and feed Arduino-compatible event text into quaddle_robot_bridge_handle_line().

config QUADDLE_BLE_GAMEPAD_NAME_FILTER
    string "Quaddle BLE gamepad name filter"
    depends on ENABLE_QUADDLE_BLE_HID_CENTRAL
    default "bm769,q34b,gamepadspace"
    help
      Comma-separated, case-insensitive advertised name substrings accepted as target gamepads.

rsource "../ai_components/Kconfig"

endmenu
```

## boards/ESP32/AI_BOARD/Kconfig
```kconfig
config CHIP_CHOICE
    string
    default "esp32s3"

config BOARD_CHOICE
    string
    default "AI_BOARD"

config UART_NUM0_TX_PIN
    int "UART_NUM0_TX_PIN"
    range 0 48
    default 35
    ---help---
        esp32-s3 default 35

config UART_NUM0_RX_PIN
    int "UART_NUM0_RX_PIN"
    range 0 48
    default 36
    ---help---
        esp32-s3 default 36

config AI_BOARD_ENABLE_LCD
    bool "Enable AI_BOARD LCD support"
    default n
    select ENABLE_ESP_DISPLAY

config BOARD_CONFIG
    bool
    default y
    select ENABLE_AUDIO
    select PLATFORM_FLASHSIZE_16M
    select ENABLE_AUDIO_CODECS
    select ENABLE_ESP32S3_USB_JTAG_ONLY
```
